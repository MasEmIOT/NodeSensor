## main/Kconfig.projbuild
```kconfig
menu "Node Sensor Configuration"

    config NODE_ID
        int "Node ID (1-255)"
        range 1 255
        default 1
        help
            Ma so dinh danh cua node, gateway dung lam key tren Firebase.

    config NODE_SEND_INTERVAL_S
        int "Send interval (seconds)"
        range 3 3600
        default 4
        help
            Chu ky do va gui du lieu. Yeu cau nhanh: dat 3 hoac 4 giay.

    config NODE_ACK_TIMEOUT_MS
        int "ACK wait timeout (ms)"
        range 100 3000
        default 800
        help
            Thoi gian doi ACK tu gateway sau moi lan gui. Phai du nho de
            tong chu ky van nam trong 3-4 giay.

    config NODE_ACK_RETRIES
        int "ACK retries (so lan gui lai khi khong co ACK)"
        range 0 5
        default 2

    config NODE_LIGHT_SLEEP
        bool "Bat hybrid light-sleep giua cac chu ky"
        default y
        help
            Sau khi gui+ACK xong, node light-sleep phan thoi gian con lai cua
            chu ky. Thuc day boi timer HOAC su kien GPIO (DIO0 cua LoRa).

    config NODE_WDT_TIMEOUT_S
        int "Watchdog timeout (seconds)"
        range 3 60
        default 10
        help
            Neu vong lap chinh treo qua thoi gian nay, chip se tu reset.

    config LORA_FREQ_HZ
        int "LoRa frequency (Hz)"
        default 433000000
        help
            Ra-02 (SX1278) dung 433 MHz. Phai giong gateway.

    config LORA_SF
        int "LoRa spreading factor (7-12)"
        range 7 12
        default 9
        help
            SF cang lon bay cang xa nhung cang cham. Phai giong gateway.
            Voi chu ky 3-4s nen dung SF7-9 de airtime du ngan.

    config LORA_TX_POWER_DBM
        int "LoRa TX power (dBm)"
        range 2 20
        default 17

endmenu
```

## sdkconfig.defaults
```kconfig
CONFIG_IDF_TARGET="esp32s3"
CONFIG_ESPTOOLPY_FLASHSIZE_4MB=y
CONFIG_PARTITION_TABLE_SINGLE_APP_LARGE=y

# Tick 1000Hz: de vTaskDelay(pdMS_TO_TICKS(<=10ms)) thuc su cho dung thoi gian
# (mac dinh 100Hz lam tron 5ms -> 0 tick, gay loi timeout LoRa).
CONFIG_FREERTOS_HZ=1000

# Manual light-sleep (esp_light_sleep_start) khong can PM framework.
# De PM_ENABLE=n cho don gian, tranh DFS can thiep vao SPI/I2C timing.
CONFIG_PM_ENABLE=n
CONFIG_FREERTOS_USE_TICKLESS_IDLE=n

# Task Watchdog: bat va cho panic (reset) khi treo
CONFIG_ESP_TASK_WDT_INIT=y
CONFIG_ESP_TASK_WDT_TIMEOUT_S=10
CONFIG_ESP_TASK_WDT_PANIC=y
```
